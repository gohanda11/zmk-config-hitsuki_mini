## boards/shields/hitsuki_mini/Kconfig.defconfig
```kconfig
if SHIELD_HITSUKI_MINI_R

config ZMK_KEYBOARD_NAME
    default "hitsuki_mini_R"

config ZMK_SPLIT
    default y

config ZMK_SPLIT_ROLE_CENTRAL
    default y

endif

if SHIELD_HITSUKI_MINI_L

config ZMK_KEYBOARD_NAME
    default "hitsuki_mini_L"

config ZMK_SPLIT
    default y

endif
```

## boards/shields/hitsuki_mini/Kconfig.shield
```kconfig
config SHIELD_HITSUKI_MINI_R
    def_bool $(shields_list_contains,hitsuki_mini_R)

config SHIELD_HITSUKI_MINI_L
    def_bool $(shields_list_contains,hitsuki_mini_L)
```
